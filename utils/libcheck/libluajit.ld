PROVIDE(luaL_addlstring       = 0);
PROVIDE(luaL_addstring        = 0);
PROVIDE(luaL_addvalue         = 0);
PROVIDE(luaL_argerror         = 0);
PROVIDE(luaL_buffinit         = 0);
PROVIDE(luaL_callmeta         = 0);
PROVIDE(luaL_checkany         = 0);
PROVIDE(luaL_checkinteger     = 0);
PROVIDE(luaL_checklstring     = 0);
PROVIDE(luaL_checknumber      = 0);
PROVIDE(luaL_checkoption      = 0);
PROVIDE(luaL_checkstack       = 0);
PROVIDE(luaL_checktype        = 0);
PROVIDE(luaL_checkudata       = 0);
PROVIDE(luaL_error            = 0);
PROVIDE(luaL_execresult       = 0);
PROVIDE(luaL_fileresult       = 0);
PROVIDE(luaL_findtable        = 0);
PROVIDE(luaL_getmetafield     = 0);
PROVIDE(luaL_gsub             = 0);
PROVIDE(luaL_loadbuffer       = 0);
PROVIDE(luaL_loadbufferx      = 0);
PROVIDE(luaL_loadfile         = 0);
PROVIDE(luaL_loadfilex        = 0);
PROVIDE(luaL_loadstring       = 0);
PROVIDE(luaL_newmetatable     = 0);
PROVIDE(luaL_newstate         = 0);
PROVIDE(luaL_openlib          = 0);
PROVIDE(luaL_openlibs         = 0);
PROVIDE(luaL_optinteger       = 0);
PROVIDE(luaL_optlstring       = 0);
PROVIDE(luaL_optnumber        = 0);
PROVIDE(luaL_prepbuffer       = 0);
PROVIDE(luaL_pushmodule       = 0);
PROVIDE(luaL_pushresult       = 0);
PROVIDE(luaL_ref              = 0);
PROVIDE(luaL_register         = 0);
PROVIDE(luaL_setfuncs         = 0);
PROVIDE(luaL_setmetatable     = 0);
PROVIDE(luaL_testudata        = 0);
PROVIDE(luaL_traceback        = 0);
PROVIDE(luaL_typerror         = 0);
PROVIDE(luaL_unref            = 0);
PROVIDE(luaL_where            = 0);
PROVIDE(lua_atpanic           = 0);
PROVIDE(lua_call              = 0);
PROVIDE(lua_checkstack        = 0);
PROVIDE(lua_close             = 0);
PROVIDE(lua_concat            = 0);
PROVIDE(lua_copy              = 0);
PROVIDE(lua_cpcall            = 0);
PROVIDE(lua_createtable       = 0);
PROVIDE(lua_dump              = 0);
PROVIDE(lua_equal             = 0);
PROVIDE(lua_error             = 0);
PROVIDE(lua_gc                = 0);
PROVIDE(lua_getallocf         = 0);
PROVIDE(lua_getfenv           = 0);
PROVIDE(lua_getfield          = 0);
PROVIDE(lua_gethook           = 0);
PROVIDE(lua_gethookcount      = 0);
PROVIDE(lua_gethookmask       = 0);
PROVIDE(lua_getinfo           = 0);
PROVIDE(lua_getlocal          = 0);
PROVIDE(lua_getmetatable      = 0);
PROVIDE(lua_getstack          = 0);
PROVIDE(lua_gettable          = 0);
PROVIDE(lua_gettop            = 0);
PROVIDE(lua_getupvalue        = 0);
PROVIDE(lua_insert            = 0);
PROVIDE(lua_iscfunction       = 0);
PROVIDE(lua_isnumber          = 0);
PROVIDE(lua_isstring          = 0);
PROVIDE(lua_isuserdata        = 0);
PROVIDE(lua_isyieldable       = 0);
PROVIDE(lua_lessthan          = 0);
PROVIDE(lua_load              = 0);
PROVIDE(lua_loadx             = 0);
PROVIDE(lua_newstate          = 0);
PROVIDE(lua_newthread         = 0);
PROVIDE(lua_newuserdata       = 0);
PROVIDE(lua_next              = 0);
PROVIDE(lua_objlen            = 0);
PROVIDE(lua_pcall             = 0);
PROVIDE(lua_pushboolean       = 0);
PROVIDE(lua_pushcclosure      = 0);
PROVIDE(lua_pushfstring       = 0);
PROVIDE(lua_pushinteger       = 0);
PROVIDE(lua_pushlightuserdata = 0);
PROVIDE(lua_pushlstring       = 0);
PROVIDE(lua_pushnil           = 0);
PROVIDE(lua_pushnumber        = 0);
PROVIDE(lua_pushstring        = 0);
PROVIDE(lua_pushthread        = 0);
PROVIDE(lua_pushvalue         = 0);
PROVIDE(lua_pushvfstring      = 0);
PROVIDE(lua_rawequal          = 0);
PROVIDE(lua_rawget            = 0);
PROVIDE(lua_rawgeti           = 0);
PROVIDE(lua_rawset            = 0);
PROVIDE(lua_rawseti           = 0);
PROVIDE(lua_remove            = 0);
PROVIDE(lua_replace           = 0);
PROVIDE(lua_resume            = 0);
PROVIDE(lua_setallocf         = 0);
PROVIDE(lua_setfenv           = 0);
PROVIDE(lua_setfield          = 0);
PROVIDE(lua_sethook           = 0);
PROVIDE(lua_setlocal          = 0);
PROVIDE(lua_setmetatable      = 0);
PROVIDE(lua_settable          = 0);
PROVIDE(lua_settop            = 0);
PROVIDE(lua_setupvalue        = 0);
PROVIDE(lua_status            = 0);
PROVIDE(lua_toboolean         = 0);
PROVIDE(lua_tocfunction       = 0);
PROVIDE(lua_tointeger         = 0);
PROVIDE(lua_tointegerx        = 0);
PROVIDE(lua_tolstring         = 0);
PROVIDE(lua_tonumber          = 0);
PROVIDE(lua_tonumberx         = 0);
PROVIDE(lua_topointer         = 0);
PROVIDE(lua_tothread          = 0);
PROVIDE(lua_touserdata        = 0);
PROVIDE(lua_type              = 0);
PROVIDE(lua_typename          = 0);
PROVIDE(lua_upvalueid         = 0);
PROVIDE(lua_upvaluejoin       = 0);
PROVIDE(lua_version           = 0);
PROVIDE(lua_xmove             = 0);
PROVIDE(lua_yield             = 0);
PROVIDE(luaL_addlstring       = 0);
PROVIDE(luaL_addstring        = 0);
PROVIDE(luaL_addvalue         = 0);
PROVIDE(luaL_argerror         = 0);
PROVIDE(luaL_buffinit         = 0);
PROVIDE(luaL_callmeta         = 0);
PROVIDE(luaL_checkany         = 0);
PROVIDE(luaL_checkinteger     = 0);
PROVIDE(luaL_checklstring     = 0);
PROVIDE(luaL_checknumber      = 0);
PROVIDE(luaL_checkoption      = 0);
PROVIDE(luaL_checkstack       = 0);
PROVIDE(luaL_checktype        = 0);
PROVIDE(luaL_checkudata       = 0);
PROVIDE(luaL_error            = 0);
PROVIDE(luaL_execresult       = 0);
PROVIDE(luaL_fileresult       = 0);
PROVIDE(luaL_findtable        = 0);
PROVIDE(luaL_getmetafield     = 0);
PROVIDE(luaL_gsub             = 0);
PROVIDE(luaL_loadbuffer       = 0);
PROVIDE(luaL_loadbufferx      = 0);
PROVIDE(luaL_loadfile         = 0);
PROVIDE(luaL_loadfilex        = 0);
PROVIDE(luaL_loadstring       = 0);
PROVIDE(luaL_newmetatable     = 0);
PROVIDE(luaL_newstate         = 0);
PROVIDE(luaL_openlib          = 0);
PROVIDE(luaL_openlibs         = 0);
PROVIDE(luaL_optinteger       = 0);
PROVIDE(luaL_optlstring       = 0);
PROVIDE(luaL_optnumber        = 0);
PROVIDE(luaL_prepbuffer       = 0);
PROVIDE(luaL_pushmodule       = 0);
PROVIDE(luaL_pushresult       = 0);
PROVIDE(luaL_ref              = 0);
PROVIDE(luaL_register         = 0);
PROVIDE(luaL_setfuncs         = 0);
PROVIDE(luaL_setmetatable     = 0);
PROVIDE(luaL_testudata        = 0);
PROVIDE(luaL_traceback        = 0);
PROVIDE(luaL_typerror         = 0);
PROVIDE(luaL_unref            = 0);
PROVIDE(luaL_where            = 0);
PROVIDE(lua_atpanic           = 0);
PROVIDE(lua_call              = 0);
PROVIDE(lua_checkstack        = 0);
PROVIDE(lua_close             = 0);
PROVIDE(lua_concat            = 0);
PROVIDE(lua_copy              = 0);
PROVIDE(lua_cpcall            = 0);
PROVIDE(lua_createtable       = 0);
PROVIDE(lua_dump              = 0);
PROVIDE(lua_equal             = 0);
PROVIDE(lua_error             = 0);
PROVIDE(lua_gc                = 0);
PROVIDE(lua_getallocf         = 0);
PROVIDE(lua_getfenv           = 0);
PROVIDE(lua_getfield          = 0);
PROVIDE(lua_gethook           = 0);
PROVIDE(lua_gethookcount      = 0);
PROVIDE(lua_gethookmask       = 0);
PROVIDE(lua_getinfo           = 0);
PROVIDE(lua_getlocal          = 0);
PROVIDE(lua_getmetatable      = 0);
PROVIDE(lua_getstack          = 0);
PROVIDE(lua_gettable          = 0);
PROVIDE(lua_gettop            = 0);
PROVIDE(lua_getupvalue        = 0);
PROVIDE(lua_insert            = 0);
PROVIDE(lua_iscfunction       = 0);
PROVIDE(lua_isnumber          = 0);
PROVIDE(lua_isstring          = 0);
PROVIDE(lua_isuserdata        = 0);
PROVIDE(lua_isyieldable       = 0);
PROVIDE(lua_lessthan          = 0);
PROVIDE(lua_load              = 0);
PROVIDE(lua_loadx             = 0);
PROVIDE(lua_newstate          = 0);
PROVIDE(lua_newthread         = 0);
PROVIDE(lua_newuserdata       = 0);
PROVIDE(lua_next              = 0);
PROVIDE(lua_objlen            = 0);
PROVIDE(lua_pcall             = 0);
PROVIDE(lua_pushboolean       = 0);
PROVIDE(lua_pushcclosure      = 0);
PROVIDE(lua_pushfstring       = 0);
PROVIDE(lua_pushinteger       = 0);
PROVIDE(lua_pushlightuserdata = 0);
PROVIDE(lua_pushlstring       = 0);
PROVIDE(lua_pushnil           = 0);
PROVIDE(lua_pushnumber        = 0);
PROVIDE(lua_pushstring        = 0);
PROVIDE(lua_pushthread        = 0);
PROVIDE(lua_pushvalue         = 0);
PROVIDE(lua_pushvfstring      = 0);
PROVIDE(lua_rawequal          = 0);
PROVIDE(lua_rawget            = 0);
PROVIDE(lua_rawgeti           = 0);
PROVIDE(lua_rawset            = 0);
PROVIDE(lua_rawseti           = 0);
PROVIDE(lua_remove            = 0);
PROVIDE(lua_replace           = 0);
PROVIDE(lua_resume            = 0);
PROVIDE(lua_setallocf         = 0);
PROVIDE(lua_setfenv           = 0);
PROVIDE(lua_setfield          = 0);
PROVIDE(lua_sethook           = 0);
PROVIDE(lua_setlocal          = 0);
PROVIDE(lua_setmetatable      = 0);
PROVIDE(lua_settable          = 0);
PROVIDE(lua_settop            = 0);
PROVIDE(lua_setupvalue        = 0);
PROVIDE(lua_status            = 0);
PROVIDE(lua_toboolean         = 0);
PROVIDE(lua_tocfunction       = 0);
PROVIDE(lua_tointeger         = 0);
PROVIDE(lua_tointegerx        = 0);
PROVIDE(lua_tolstring         = 0);
PROVIDE(lua_tonumber          = 0);
PROVIDE(lua_tonumberx         = 0);
PROVIDE(lua_topointer         = 0);
PROVIDE(lua_tothread          = 0);
PROVIDE(lua_touserdata        = 0);
PROVIDE(lua_type              = 0);
PROVIDE(lua_typename          = 0);
PROVIDE(lua_upvalueid         = 0);
PROVIDE(lua_upvaluejoin       = 0);
PROVIDE(lua_version           = 0);
PROVIDE(lua_xmove             = 0);
PROVIDE(lua_yield             = 0);
